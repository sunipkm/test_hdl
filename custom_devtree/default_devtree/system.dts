/*
 * CAUTION: This file is automatically generated by Xilinx.
 * Version:  
 * Today is: Thu May 21 15:37:26 2020
 */


&gem0 {
	local-mac-address = [00 0a 35 00 00 00];
};
&gem1 {
	local-mac-address = [00 0a 35 00 00 01];
};
